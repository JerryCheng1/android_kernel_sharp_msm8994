## drivers/sharp-8992/Kconfig
```kconfig
#
# SHARP configuration
#
menu "SHARP Device Drivers"

source "drivers/sharp-8992/shdiag/Kconfig"
#source "drivers/sharp-8992/vold/Kconfig"

#source "drivers/sharp-8992/shbatt/Kconfig"

# SH_BOOT_CUST start
source "drivers/sharp-8992/shboot/Kconfig"
# SH_BOOT_CUST end
source "drivers/sharp-8992/shdisp/Kconfig"

source "drivers/sharp-8992/shsensor_hub/ml630q790/Kconfig"
#source "drivers/sharp-8992/shlog/Kconfig"
#source "drivers/sharp-8992/shgrip/Kconfig"

#source "drivers/sharp-8992/tunerdrv/Kconfig"
#source "drivers/sharp-8992/tunerdrv_tmm/Kconfig"
source "drivers/sharp-8992/shterm/Kconfig"
#source "drivers/sharp-8992/shfpsensor/Kconfig"
#/* SH_AUDIO_DRIVER -> */ /* 18-002 */
source "drivers/sharp-8992/shaudio/Kconfig"
#/* SH_AUDIO_DRIVER <- */ /* 18-002 */
#source "drivers/sharp-8992/proximity/Kconfig"
#source "drivers/sharp-8992/nfc/Kconfig"
#source "drivers/sharp-8992/shflip/Kconfig"
source "drivers/sharp-8992/shtps/Kconfig"
#source "drivers/sharp-8992/shtimer/Kconfig"
#source "drivers/sharp-8992/shcamled/Kconfig"

endmenu
```

## drivers/sharp-8992/shcamled/Kconfig
```kconfig
#
# Camera Picture Light LED Configration
#

menu "SHARP Camera LED"

comment "SHARP Camera LED"

config SHCAMERA_PICT
        bool "Sharp Camera Picture Light"
        default n
        ---help---
          This flag enables Sharp Camera Picture Light.

config SHCAMERA_PDAF
        bool "Sharp Camera MH-1 companionchip"
        default n
        ---help---
          This flag enables Sharp Camera MH-1 companionchip.

endmenu
```

## drivers/sharp-8992/shtps/sy3000/Kconfig
```kconfig
#
# Sharp Touchscreen configuration
#

if TOUCHSCREEN_SHTPS

	config SHTPS_SY3X00_DEV
		tristate "SY3x00 Device"
		default n
		depends on TOUCHSCREEN_SHTPS

	config SHTPS_SY3000_PLG541_001_1
		tristate "SY3000 PLG541-001-1"
		default n
		depends on SHTPS_SY3X00_DEV

	config SHTPS_SY3000_PLG541_001_2
		tristate "SY3000 PLG541-001-2"
		default n
		depends on SHTPS_SY3X00_DEV

	config SHTPS_SY3000_PLG543_001_1
		tristate "SY3000 PLG543-001-1"
		default n
		depends on SHTPS_SY3X00_DEV

	config SHTPS_SY3000_PLG543_001_2
		tristate "SY3000 PLG543-001-2"
		default n
		depends on SHTPS_SY3X00_DEV

	config SHTPS_SY3000_PLG543_001_3
		tristate "SY3000 PLG543-001-3"
		default n
		depends on SHTPS_SY3X00_DEV

	config SHTPS_SY3000_PLG543_001_4
		tristate "SY3000 PLG543-001-4"
		default n
		depends on SHTPS_SY3X00_DEV

endif # TOUCHSCREEN_SHTPS
```
