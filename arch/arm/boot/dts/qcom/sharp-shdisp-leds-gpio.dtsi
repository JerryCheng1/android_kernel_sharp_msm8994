/* Copyright (c) 2015, The Linux Foundation. All rights reserved.
 *
 * This program is free software; you can redistribute it and/or modify
 * it under the terms of the GNU General Public License version 2 and
 * only version 2 as published by the Free Software Foundation.
 *
 * This program is distributed in the hope that it will be useful,
 * but WITHOUT ANY WARRANTY; without even the implied warranty of
 * MERCHANTABILITY or FITNESS FOR A PARTICULAR PURPOSE.  See the
 * GNU General Public License for more details.
 */

/*****************************************/
/*  pm8994-leds-gpios: qpnp-pin          */
/*****************************************/
&soc {
	sharp,shdisp_leds_gpio {
		compatible = "sharp,shdisp_leds_gpio";
		pierce_sel_pmi_gpio = <&pmi8994_gpios 3 0>;
		pierce_dis_sw_gpio = <&pm8994_gpios 10 0>;
		status = "okay";
	};
};
